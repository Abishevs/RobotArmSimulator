#include <WiFi.h>
#include <ArduinoWebsockets.h>
#include <ESPmDNS.h>
#include <ArduinoJson.h>

#include "config.h" 

const char* websocket_server = "ws://192.168.1.65:8000"; 

using namespace websockets;
WebsocketsClient client;

void onMessageCallback(WebsocketsMessage message) {
  Serial.print("Got Message: ");
  Serial.println(message.data());

  StaticJsonDocument<256> doc; // Adjust size according to your needs
  DeserializationError error = deserializeJson(doc, message.data());

  if (error) {
    Serial.print(F("deserializeJson() failed: "));
    Serial.println(error.c_str());
    return;
  }

  // Example of extracting fields from the received JSON
  const char* servo = doc["jointId"];
  long angle = doc["angle"];
  Serial.println(servo);
  Serial.println(angle);
    // Use the extracted data as needed...
}

void setup() {
  Serial.begin(115200);

  // Connect to WiFi
  WiFi.begin(ssid, password);
  while(WiFi.status() != WL_CONNECTED) {
    delay(1000);
    Serial.println("Connecting to WiFi...");
  }

  // Initialize mDNS
  if (!MDNS.begin("esp32")) {
    Serial.println("Error setting up MDNS responder!");
    while (1) {
      delay(1000);
    }
  }

  // Connect to WebSocket server
  client.onMessage(onMessageCallback);
    if (client.connect(websocket_server)) {
    Serial.println("Connected to the WebSocket server.");
    
    // Construct an initial JSON message
    StaticJsonDocument<200> doc;
    doc["type"] = "init";
    doc["message"] = "Hello from ESP32";
    
    String jsonString;
    serializeJson(doc, jsonString); // Serialize the JSON object to a string
    
    client.send(jsonString); // Send the JSON message
  } else {
    Serial.println("Connection to WebSocket server failed.");
  }
  // client.connect(websocket_server);
  // Serial.println("Connected to the WebSocket server.");
}
void getJson() {
	// generated by https://arduinojson.org/v7/assistant
	// String input;
	JsonDocument doc;

	DeserializationError error = deserializeJson(doc, input);

	if (error) {
		Serial.print("deserializeJson() failed: ");
		Serial.println(error.c_str());
		return;
	}

	const char* messageType = doc["messageType"]; // "positionUpdate"
	const char* identifier = doc["identifier"]; // "12345"
	const char* source = doc["source"]; // "GUI"
	const char* target = doc["target"]; // "ESP32"

	for (JsonObject payload_position : doc["payload"]["positions"].as<JsonArray>()) {

		int payload_position_jointId = payload_position["jointId"]; // 1, 2, 3
		int payload_position_currentAngle = payload_position["currentAngle"]; // 45, 90, 135

	}

}
void loop() {
  client.poll();
  
  // The following is an example of sending a message to the WebSocket server every 10 seconds
  static unsigned long lastTime = 0;
  if (millis() - lastTime > 10000) {
    lastTime = millis();
    StaticJsonDocument<200> doc;
    doc["type"] = "init";
    doc["message"] = lastTime;

    String jsonString;
    serializeJson(doc, jsonString);

    client.send(jsonString);
  }
}

